/*
 * Copyright (c) 2020 The ZMK Contributors
 * Copyright (c) 2023 Innaworks Development Limited, trading as MoErgo
 *
 * SPDX-License-Identifier: MIT
 */
/* THIS FILE WAS GENERATED BY GLOVE80 LAYOUT EDITOR
 *
 * This file was generated automatically. You may or may not want to
 * edit it directly.
 */
/* Include all behaviour includes needed */

#include <behaviors.dtsi>
#include <dt-bindings/zmk/bt.h>
#include <dt-bindings/zmk/keys.h>
#include <dt-bindings/zmk/outputs.h>
#include <dt-bindings/zmk/rgb.h>

/* Automatically generated layer name #define */

#define LAYER_Base 0
#define LAYER_Mouse 1
#define LAYER_Magic 2

/* To deal with the situation where there is no Lower layer, to keep &lower happy */

#ifndef LAYER_Lower

#define LAYER_Lower 0

#

endif {
    /* Custom Device-tree */
    /* Glove80 system behavior & macros */

    /

    behaviors {
        // For the "layer" key, it'd nice to be able to use it as either a shift or a toggle.
        // Configure it as a tap dance, so the first tap (or hold) is a &mo and the second tap is a &to

        lower: lower {
            compatible = "zmk,behavior-tap-dance";
            label = "LAYER_TAP_DANCE";
            #binding-cells = <0>;
            tapping-term-ms = <200>;
            bindings = <&mo LAYER_Lower>, <&to LAYER_Lower>;
        };
    };
};

/ {
    macros {
        rgb_ug_status_macro: rgb_ug_status_macro {
            label = "RGB_UG_STATUS";
            compatible = "zmk,behavior-macro";
            #binding-cells = <0>;
            bindings = <&rgb_ug RGB_STATUS>;
        };
    };
};

/ {
    #ifdef BT_DISC_CMD

    behaviors {
        bt_0: bt_0 {
            compatible = "zmk,behavior-tap-dance";
            label = "BT_0";
            #binding-cells = <0>;
            tapping-term-ms = <200>;
            bindings = <&bt_select_0>, <&bt BT_DISC 0>;
        };

        bt_1: bt_1 {
            compatible = "zmk,behavior-tap-dance";
            label = "BT_1";
            #binding-cells = <0>;
            tapping-term-ms = <200>;
            bindings = <&bt_select_1>, <&bt BT_DISC 1>;
        };

        bt_2: bt_2 {
            compatible = "zmk,behavior-tap-dance";
            label = "BT_2";
            #binding-cells = <0>;
            tapping-term-ms = <200>;
            bindings = <&bt_select_2>, <&bt BT_DISC 2>;
        };

        bt_3: bt_3 {
            compatible = "zmk,behavior-tap-dance";
            label = "BT_3";
            #binding-cells = <0>;
            tapping-term-ms = <200>;
            bindings = <&bt_select_3>, <&bt BT_DISC 3>;
        };
    };

    macros {
        bt_select_0: bt_select_0 {
            label = "BT_SELECT_0";
            compatible = "zmk,behavior-macro";
            #binding-cells = <0>;
            bindings = <&out OUT_BLE &bt BT_SEL 0>;
        };

        bt_select_1: bt_select_1 {
            label = "BT_SELECT_1";
            compatible = "zmk,behavior-macro";
            #binding-cells = <0>;
            bindings = <&out OUT_BLE &bt BT_SEL 1>;
        };

        bt_select_2: bt_select_2 {
            label = "BT_SELECT_2";
            compatible = "zmk,behavior-macro";
            #binding-cells = <0>;
            bindings = <&out OUT_BLE &bt BT_SEL 2>;
        };

        bt_select_3: bt_select_3 {
            label = "BT_SELECT_3";
            compatible = "zmk,behavior-macro";
            #binding-cells = <0>;
            bindings = <&out OUT_BLE &bt BT_SEL 3>;
        };
    };

    #else

    macros {
        bt_0: bt_0 {
            label = "BT_0";
            compatible = "zmk,behavior-macro";
            #binding-cells = <0>;
            bindings = <&out OUT_BLE &bt BT_SEL 0>;
        };

        bt_1: bt_1 {
            label = "BT_1";
            compatible = "zmk,behavior-macro";
            #binding-cells = <0>;
            bindings = <&out OUT_BLE &bt BT_SEL 1>;
        };

        bt_2: bt_2 {
            label = "BT_2";
            compatible = "zmk,behavior-macro";
            #binding-cells = <0>;
            bindings = <&out OUT_BLE &bt BT_SEL 2>;
        };

        bt_3: bt_3 {
            label = "BT_3";
            compatible = "zmk,behavior-macro";
            #binding-cells = <0>;
            bindings = <&out OUT_BLE &bt BT_SEL 3>;
        };
    };

    #endif
};

/ {
    behaviors {
        magic: magic {
            compatible = "zmk,behavior-hold-tap";
            label = "MAGIC_HOLD_TAP";
            #binding-cells = <2>;
            flavor = "tap-preferred";
            tapping-term-ms = <200>;
            bindings = <&mo>, <&rgb_ug_status_macro>;
        };
    };
};

/* #define for key positions */

#define POS_LH_T1 52
#define POS_LH_T2 53
#define POS_LH_T3 54
#define POS_LH_T4 69
#define POS_LH_T5 70
#define POS_LH_T6 71
#define POS_LH_C1R2 15
#define POS_LH_C1R3 27
#define POS_LH_C1R4 39
#define POS_LH_C1R5 51
#define POS_LH_C2R1 4
#define POS_LH_C2R2 14
#define POS_LH_C2R3 26
#define POS_LH_C2R4 38
#define POS_LH_C2R5 50
#define POS_LH_C2R6 68
#define POS_LH_C3R1 3
#define POS_LH_C3R2 13
#define POS_LH_C3R3 25
#define POS_LH_C3R4 37
#define POS_LH_C3R5 49
#define POS_LH_C3R6 67
#define POS_LH_C4R1 2
#define POS_LH_C4R2 12
#define POS_LH_C4R3 24
#define POS_LH_C4R4 36
#define POS_LH_C4R5 48
#define POS_LH_C4R6 66
#define POS_LH_C5R1 1
#define POS_LH_C5R2 11
#define POS_LH_C5R3 23
#define POS_LH_C5R4 35
#define POS_LH_C5R5 47
#define POS_LH_C5R6 65
#define POS_LH_C6R1 0
#define POS_LH_C6R2 10
#define POS_LH_C6R3 22
#define POS_LH_C6R4 34
#define POS_LH_C6R5 46
#define POS_LH_C6R6 64
#define POS_RH_T1 57
#define POS_RH_T2 56
#define POS_RH_T3 55
#define POS_RH_T4 74
#define POS_RH_T5 73
#define POS_RH_T6 72
#define POS_RH_C1R2 16
#define POS_RH_C1R3 28
#define POS_RH_C1R4 40
#define POS_RH_C1R5 58
#define POS_RH_C2R1 5
#define POS_RH_C2R2 17
#define POS_RH_C2R3 29
#define POS_RH_C2R4 41
#define POS_RH_C2R5 59
#define POS_RH_C2R6 75
#define POS_RH_C3R1 6
#define POS_RH_C3R2 18
#define POS_RH_C3R3 30
#define POS_RH_C3R4 42
#define POS_RH_C3R5 60
#define POS_RH_C3R6 76
#define POS_RH_C4R1 7
#define POS_RH_C4R2 19
#define POS_RH_C4R3 31
#define POS_RH_C4R4 43
#define POS_RH_C4R5 61
#define POS_RH_C4R6 77
#define POS_RH_C5R1 8
#define POS_RH_C5R2 20
#define POS_RH_C5R3 32
#define POS_RH_C5R4 44
#define POS_RH_C5R5 62
#define POS_RH_C5R6 78
#define POS_RH_C6R1 9
#define POS_RH_C6R2 21
#define POS_RH_C6R3 33
#define POS_RH_C6R4 45
#define POS_RH_C6R5 63
#define POS_RH_C6R6 79

/* Custom Defined Behaviors */

/ {
    //
// ENABLE_MOUSE_KEYS activates support for mouse keys if defined; otherwise
// mouse keys are deactivated (they're transformed into no-ops) by default.
// To use this feature, uncomment the following line (remove leading "//").

#define ENABLE_MOUSE_KEYS // requires PR23 beta firmware: see note below

//////////////////////////////////////////////////////////////////////////
//
// Mouse keys (control mouse via keyboard) -- requires PR23 beta firmware:
// select "community.pr23.mouse-keys" from the drop-down menu located at
// Glove80 Layout Editor > Settings > Advanced Settings > Firmware Version
//
// https://gist.github.com/krissen/dd27082e7ab0575619c7a31f4d2ec7ae
// https://github.com/zmkfirmware/zmk/compare/main...urob:zmk:mouse-3.2
// https://dev.glove80.com/#/layout/user/1d17ccc0-069c-4ec4-a2c3-69d941befc8f
//
//////////////////////////////////////////////////////////////////////////

//////////////////////////////////////////////////////////////////////
// NOTE: Use the `#define` settings below to customize this keymap! //
//////////////////////////////////////////////////////////////////////
// NOTE: This code is forked and extracted from the following repo:
//
// Sunaku's Keymap v31 -- "Glorious Engrammer"
// - https://github.com/sunaku/glove80-keymaps
//
// Approprate credit goes to Sunaku for the original code.
// Approprate credit goes to BryanForbes for the community.pr23.mouse-keys firmware.
// 
//////////////////////////////////////////////////////////////////////

//
// MOUSE_MOVE_DELAY defines how long to wait (milliseconds) before starting
// to move the mouse pointer.
//
#ifndef MOUSE_MOVE_DELAY
#define MOUSE_MOVE_DELAY 0
#endif

//
// MOUSE_MOVE_ACCELERATION_EXPONENT sets how the mouse pointer accelerates:
//
// acceleration exponent 0: uniform speed
// acceleration exponent 1: uniform acceleration
// acceleration exponent 2: uniform jerk
//
#ifndef MOUSE_MOVE_ACCELERATION_EXPONENT
#define MOUSE_MOVE_ACCELERATION_EXPONENT 1
#endif

//
// MOUSE_MOVE_TIME_TO_MAXIMUM_SPEED defines how long to wait (milliseconds)
// before the mouse pointer speed is suddenly boosted to the maximum value.
//
#ifndef MOUSE_MOVE_TIME_TO_MAXIMUM_SPEED
#define MOUSE_MOVE_TIME_TO_MAXIMUM_SPEED 400
#endif

//
// MOUSE_MOVE_MAXIMUM_SPEED defines how quickly the mouse pointer can move.
//
#ifndef MOUSE_MOVE_MAXIMUM_SPEED
#define MOUSE_MOVE_MAXIMUM_SPEED 850
#endif

//
// MOUSE_SCROLL_DELAY defines how long to wait (milliseconds) before starting
// to move the mouse pointer.
//
#ifndef MOUSE_SCROLL_DELAY
#define MOUSE_SCROLL_DELAY 0
#endif

//
// MOUSE_SCROLL_ACCELERATION_EXPONENT sets how the mouse pointer accelerates:
//
// acceleration exponent 0: uniform speed
// acceleration exponent 1: uniform acceleration
// acceleration exponent 2: uniform jerk
//
#ifndef MOUSE_SCROLL_ACCELERATION_EXPONENT
#define MOUSE_SCROLL_ACCELERATION_EXPONENT 0
#endif

//
// MOUSE_SCROLL_TIME_TO_MAXIMUM_SPEED defines how long to wait (milliseconds)
// before the mouse pointer speed is suddenly boosted to the maximum value.
//
#ifndef MOUSE_SCROLL_TIME_TO_MAXIMUM_SPEED
#define MOUSE_SCROLL_TIME_TO_MAXIMUM_SPEED 300
#endif

//
// MOUSE_SCROLL_MAXIMUM_SPEED defines how quickly the mouse wheel can scroll.
//
#ifndef MOUSE_SCROLL_MAXIMUM_SPEED
#define MOUSE_SCROLL_MAXIMUM_SPEED 15
#endif

/*HACK*/};
#ifdef ENABLE_MOUSE_KEYS
    // ==== MOUSE-KEY <section begins> ====
    #include <dt-bindings/zmk/mouse.h>

    &mmv {
      delay-ms = <MOUSE_MOVE_DELAY>;
      acceleration-exponent = <MOUSE_MOVE_ACCELERATION_EXPONENT>;
      time-to-max-speed-ms = <MOUSE_MOVE_TIME_TO_MAXIMUM_SPEED>;
      #define U_MOUSE_MOVE_MAX MOUSE_MOVE_MAXIMUM_SPEED
    };

    &msc {
      delay-ms = <MOUSE_SCROLL_DELAY>;
      acceleration-exponent = <MOUSE_SCROLL_ACCELERATION_EXPONENT>;
      time-to-max-speed-ms = <MOUSE_SCROLL_TIME_TO_MAXIMUM_SPEED>;
      #define U_MOUSE_SCROLL_MAX MOUSE_SCROLL_MAXIMUM_SPEED
    };
    #undef MOVE_UP
    #undef MOVE_DOWN
    #undef MOVE_LEFT
    #undef MOVE_RIGHT
    #define MOVE_UP MOVE_Y(-U_MOUSE_MOVE_MAX)
    #define MOVE_DOWN MOVE_Y(U_MOUSE_MOVE_MAX)
    #define MOVE_LEFT MOVE_X(-U_MOUSE_MOVE_MAX)
    #define MOVE_RIGHT MOVE_X(U_MOUSE_MOVE_MAX)
    #undef SCRLL_UP
    #undef SCRLL_DOWN
    #undef SCRLL_LEFT
    #undef SCRLL_RIGHT
    #define SCRLL_UP SCRLL_Y(U_MOUSE_SCROLL_MAX)
    #define SCRLL_DOWN SCRLL_Y(-U_MOUSE_SCROLL_MAX)
    #define SCRLL_LEFT SCRLL_X(-U_MOUSE_SCROLL_MAX)
    #define SCRLL_RIGHT SCRLL_X(U_MOUSE_SCROLL_MAX)
    // ==== MOUSE-KEY <section ends> =====
#else

#define mkp none
#define mmv none
#define msc none
#define LCLK
    #define MCLK
#define RCLK
    #define MB1
#define MB2
    #define MB3
#define MB4
    #define MB5
#define MB6
    #define MB7
#define MB8
    #define MOVE_UP
#define MOVE_DOWN
    #define MOVE_LEFT
#define MOVE_RIGHT
    #define SCRL_UP
#define SCRL_DOWN
    #define SCRL_LEFT
#define SCRL_RIGHT

#

endif {
    /*HACK*/

    /
};

/* Automatically generated macro definitions */

/ {
    macros {
        test: test {
            label = "&TEST";
            compatible = "zmk,behavior-macro";
            #binding-cells = <0>;
            bindings = <&kp L &kp O &kp L &kp A>;
        };

        doublectrl: doublectrl {
            label = "&DOUBLECTRL";
            compatible = "zmk,behavior-macro";
            #binding-cells = <0>;
            bindings = <&kp LCTRL &kp LCTRL>;
        };
    };
};

/* Automatically generated keymap */

/ {
    combos {
        compatible = "zmk,combos";

        testererer {
            bindings = <&test>;
            key-positions = <39 40>;
        };

        idk {
            bindings = <&doublectrl>;
            key-positions = <4 5>;
        };

        booty {
            bindings = <&test>;
            key-positions = <15 16>;
        };
    };

    keymap {
        compatible = "zmk,keymap";

        layer_Base {
            bindings = <
&kp LG(LS(I))         &kp C_QUIT      &kp LC(LA(LG(COMMA)))  &kp A           &kp C_PP                                                                                                                                 &kp RG(RS(DOT))  &kp LG(P)        &kp LC(LS(G))  &kp RG(RC(RS(T)))  &kp LG(LS(O))
&kp EQUAL             &mt EXCL KP_N1  &mt AT KP_N2           &mt HASH KP_N3  &mt DLLR KP_N4  &mt PRCNT KP_N5                                                                                            &mt CARET N6  &mt AMPS N7      &mt STAR N8      &mt LPAR N9    &mt QMARK N0       &mt RPAR MINUS
&kp LG(Z)             &kp Q           &kp W                  &kp E           &kp R           &kp T                                                                                                      &kp Y         &kp U            &kp I            &kp O          &kp P              &kp RG(L)
&kp LG(Y)             &kp A           &kp S                  &kp D           &kp F           &kp G                                                                                                      &kp H         &kp J            &kp K            &kp L          &kp SEMI           &kp SQT
&kp RG(SEMI)          &kp Z           &kp X                  &kp C           &kp V           &kp B            &kp LA(BSPC)    &kp LG(BSPC)  &kp LGUI      &kp RGUI            &kp LCTRL    &kp RET      &kp N         &kp M            &mt LG(K) COMMA  &mt DOT DOT    &mt FSLH LBKT      &kp PG_UP
&magic LAYER_Magic 0  &kp RG(SQT)     &kp RG(COMMA)          &kp RG(DOT)     &kp RG(FSLH)                     &mt LSHFT BSPC  &kp TAB       &mt LALT ESC  &mt LALT LG(SPACE)  &doublectrl  &lt 1 SPACE                &kp LC(LS(TAB))  &kp LC(TAB)      &kp LG(T)      &kp LG(W)          &kp PG_DN
            >;
        };

        layer_Mouse {
            bindings = <
&none              &none          &kp LG(LS(LA(N)))        &kp LA(T)               &kp LG(LA(LS(R)))                                                                                                   &none                          &none                          &none                            &none           &none
&none              &none          &none                    &none                   &none                   &kp LG(C)                                                                     &kp LG(V)     &kp LC(LEFT)                   &kp LC(UP)                     &kp LC(RIGHT)                    &none           &none
&none              &kp LS(LA(R))  &mt LC(LA(H)) LG(LA(H))  &kp RS(RA(RG(LC(N8))))  &kp RS(RA(RG(LC(N9))))  &kp RG(RS(N2))                                                                &mkp RCLK     &msc SCRL_LEFT                 &mmv MOVE_UP                   &msc SCRL_RIGHT                  &msc SCRL_UP    &none
&none              &kp LA(J)      &mt LS(LC(S)) LS(LG(S))  &trans                  &kp LA(R)               &kp RG(RS(N4))                                                                &mkp LCLK     &mmv MOVE_LEFT                 &mmv MOVE_DOWN                 &mmv MOVE_RIGHT                  &msc SCRL_DOWN  &kp RS(RA(RGUI))
&kp LS(LA(LC(K)))  &kp LA(T)      &kp LS(LC(LA(B)))        &kp LS(LC(LA(T)))       &kp LS(LC(LA(C)))       &kp LS(LA(LC(O)))  &kp TAB   &kp ESC       &kp LGUI      &none  &none  &to 0  &kp LG(LEFT)  &mt LS(LC(LG(LA(LEFT)))) LEFT  &mt LC(LS(LG(LA(UP)))) UP      &mt LC(LS(LG(LA(RIGHT)))) RIGHT  &kp LG(RIGHT)   &kp LG(UP)
&kp LS(LA(LC(A)))  &none          &kp LS(LC(LA(M)))        &kp LS(LC(LA(Y)))       &kp RA(M)                                  &kp BSPC  &kp LA(BSPC)  &kp LG(BSPC)  &none  &to 0  &none                &kp RA(LEFT)                   &mt LC(LS(LG(LA(DOWN)))) DOWN  &kp RA(RIGHT)                    &kp LG(DOWN)    &none
            >;
        };

        layer_Magic {
            bindings = <
&bt BT_CLR   &none            &none            &none            &none                                                                                     &none  &none  &none  &none  &bt BT_CLR_ALL
&none        &none            &none            &none            &none            &none                                                             &none  &none  &none  &none  &none  &none
&none        &rgb_ug RGB_SPI  &rgb_ug RGB_SAI  &rgb_ug RGB_HUI  &rgb_ug RGB_BRI  &rgb_ug RGB_TOG                                                   &none  &none  &none  &none  &none  &none
&bootloader  &rgb_ug RGB_SPD  &rgb_ug RGB_SAD  &rgb_ug RGB_HUD  &rgb_ug RGB_BRD  &rgb_ug RGB_EFF                                                   &none  &none  &none  &none  &none  &bootloader
&sys_reset   &none            &none            &none            &none            &none            &bt_2  &bt_3  &none         &none  &none  &none  &none  &none  &none  &none  &none  &sys_reset
&none        &none            &none            &none            &none                             &bt_0  &bt_1  &out OUT_USB  &none  &none  &none         &none  &none  &none  &none  &to 0
            >;
        };
    };
};
